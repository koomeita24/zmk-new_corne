## config/Kconfig
```kconfig
#
# Copyright (c) 2022 The ZMK Contributors
# SPDX-License-Identifier: MIT
#

config BOARD_CORNE_LEFT
    bool

config BOARD_CORNE_RIGHT
    bool

CONFIG_ZMK_PM_SOFT_OFF=y
```
